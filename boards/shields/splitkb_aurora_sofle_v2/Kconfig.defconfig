## boards/shields/splitkb_aurora_sofle_v2/Kconfig.defconfig
```kconfig
if SHIELD_SPLITKB_AURORA_SOFLE_V2_LEFT

# Name must be less than 16 characters long!
config ZMK_KEYBOARD_NAME
	default "SofleV2"

config ZMK_SPLIT_ROLE_CENTRAL
	default y

endif

if SHIELD_SPLITKB_AURORA_SOFLE_V2_LEFT || SHIELD_SPLITKB_AURORA_SOFLE_V2_RIGHT

config ZMK_SPLIT
	default y

if ZMK_DISPLAY

config I2C
	default y

config SSD1306
	default y

endif # ZMK_DISPLAY

endif
```

## boards/shields/splitkb_aurora_sofle_v2/Kconfig.shield
```kconfig
# No whitespace after the comma or in your part name!
config SHIELD_SPLITKB_AURORA_SOFLE_V2_LEFT
	def_bool $(shields_list_contains,splitkb_aurora_sofle_v2_left)

# No whitespace after the comma or in your part name!
config SHIELD_SPLITKB_AURORA_SOFLE_V2_RIGHT
	def_bool $(shields_list_contains,splitkb_aurora_sofle_v2_right)
```
